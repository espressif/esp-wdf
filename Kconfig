## Kconfig
```kconfig
#
# For a description of the syntax of this configuration file,
# see kconfig/kconfig-language.txt.
#
mainmenu "Espressif Webassembly Development Framework Configuration"

    config IDF_CMAKE
        bool
        option env="IDF_CMAKE"

    source "$COMPONENT_KCONFIGS_PROJBUILD_SOURCE_FILE"

    menu "Compiler options"

        choice COMPILER_OPTIMIZATION
            prompt "Optimization Level"
            default COMPILER_OPTIMIZATION_DEFAULT
            help
                This option sets compiler optimization level (gcc -O argument) for the app.

                - The "Default" setting will add the -0g flag to CFLAGS.
                - The "Size" setting will add the -0s flag to CFLAGS.
                - The "Performance" setting will add the -O3 flag to CFLAGS.
                - The "None" setting will add the -O0 flag to CFLAGS.

                The "Size" setting cause the compiled code to be smaller and faster, but
                may lead to difficulties of correlating code addresses to source file
                lines when debugging.

                The "Performance" setting causes the compiled code to be larger and faster,
                but will be easier to correlated code addresses to source file lines.

                "None" with -O0 produces compiled code without optimization.

                Note that custom optimization levels may be unsupported.

            config COMPILER_OPTIMIZATION_DEFAULT
                bool "Debug (-Og)"
            config COMPILER_OPTIMIZATION_SIZE
                bool "Optimize for size (-Os)"
            config COMPILER_OPTIMIZATION_PERF
                bool "Optimize for performance (-O3)"
            config COMPILER_OPTIMIZATION_NONE
                bool "Debug without optimization (-O0)"

        endchoice

        config COMPILER_WASI_NO_USE_STDLIB
            bool "Don't use the standard system startup files or libraries when linking"
            default y
            help
                In this mode, the libc-builtin library of WAMR must be built to run the
                wasm app, otherwise, the libc-wasi library must be built.

        config COMPILER_WASI_STACK_SIZE
            int "Set the auxiliary stack size"
            default 8192
            help
                The auxiliary stack size, which is an area of linear memory, must be smaller
                than the initial memory size.

        config COMPILER_WASI_USE_SHARED_MEMORY
            bool "Use shared linear memory"
            default n
            help
                Use shared linear memory.

        config COMPILER_WASI_INITIAL_MEMORY
            int "Set initial size of the linear memory"
            default 65536
            help
                Initial size of the linear memory, which must be a multiple of 65536.

        config COMPILER_WASI_MAX_MEMORY
            int "Set maximum size of the linear memory"
            default 65536
            help
                Maximum size of the linear memory, which must be a multiple of 65536.

    endmenu # Compiler Options

    menu "Component config"
        source "$COMPONENT_KCONFIGS_SOURCE_FILE"
    endmenu
```

## components/extended_wasm_app/Kconfig
```kconfig
menu "Extended WASM Applications"
    config WDF_EXT_WASM_APP_MQTT
        bool "Enable ESP-MQTT"
        default y
    
    config WDF_EXT_WASM_APP_LVGL
        bool "Enable LVGL"
        default y
    
    if WDF_EXT_WASM_APP_LVGL
        menu "LVGL"
            config USING_CUSTOMER_LV_CONF_H
                bool "Using Customer \"lv_conf.h\""
                default n
                help
                    Users just keep this option disable if not modify options of LVGL
                    in esp-wasmachine. Otherwise select this option, then lvgl will not use
                    "lv_conf.h" in directory of "components/extended_wasm_app/esp_lvgl/include/config",
                    and users can add customized "lv_conf.h".

            config LV_COLOR_16_SWAP
                bool "Swap the 2 bytes of RGB565 color. Useful if the display has an 8-bit interface (e.g. SPI)."
                default y
                help
                    If the BSP is esp-box, please enable this configuration item.
                    If the BSP is esp32_p4_function_ev_board, please disable this configuration item.
        endmenu
    endif

    config WDF_EXT_WASM_APP_HTTP_CLIENT
        bool "Enable ESP HTTP client"
        default y

    config WDF_EXT_WASM_APP_WIFI_PROVISIONING
        bool "Enable wifi provisioning"
        default y

    config WDF_EXT_WASM_APP_RMAKER
        bool "Enable ESP RainMaker"
        default y

endmenu
```

## components/wamr/Kconfig
```kconfig
menu "WAMR Configuration"

    config WAMR_APP_FRAMEWORK
        bool "Enable App Framework of WAMR"
        default n
        help
            For WAMR's App Framework support, please refer to WAMR's documents.

    if WAMR_APP_FRAMEWORK
        config WAMR_APP_FRAMEWORK_EXPORT_REQUEST_RESPONSE
            bool "export on_request & on_response"
            default n
            help
                Export on_request & on_response, which will be used by runtime. If you use
                request module of WAMR's app-framework, use functins: `api_register_resource_handler`
                & `api_send_request`, you need to enable this option.

        config WAMR_APP_FRAMEWORK_EXPORT_TIMER
            bool "export on_timer_callback"
            default n
            help
                Export on_timer_callback, which will be used by runtime. If you use timer
                module of WAMR's app-framework, use function: `api_timer_create`, you need
                to enable this option.
    endif

    menu "Extended Libc Configuration"
        config WAMR_EXTENDED_LIBC_IOCTL
            bool "Enable Extended \"ioctl\""
            default y
            help
                Select this option, then extended "ioctl" is enable, users can use peripheral
                VFS drivers' ioctl function, and input structure's members are transformed to
                data sequence to avoid issue of passing structure pointer to runtime directly.


        menu "Peripherals of Standard I/O"
            depends on WAMR_EXTENDED_LIBC_IOCTL

            config IOCTL_GPIO
                bool "GPIO"
                default y
                help
                    Select this option, then users can use GPIO command in function "ioctl".

            config IOCTL_I2C
                bool "I2C"
                default y
                help
                    Select this option, then users can use I2C command in function "ioctl".

            config IOCTL_SPI
                bool "SPI"
                default y
                help
                    Select this option, then users can use SPI command in function "ioctl".

            config IOCTL_LEDC
            bool "LEDC"
            default y
            help
                Select this option, then users can use LEDC command in function "ioctl".
    endmenu
    endmenu

    menu "Extended Socket Configuration"
        config WAMR_EXTENDED_SOCKET
                bool "Enable Extended socket"
                default y
    endmenu
endmenu
```

## examples/peripherals/gpio/gpio_simple/main/Kconfig.projbuild
```kconfig
menu "Example Configuration"

    config GPIO_SIMPLE_GPIO_PIN_NUM
        int "GPIO Pin Number"
        default 9

endmenu
```

## examples/peripherals/uart/uart_simple/main/Kconfig.projbuild
```kconfig
menu "Example Configuration"

    choice UART_DEVICE
        prompt "Select UART Device"
        default UART_DEVICE_USB_SERIAL_JTAG_CONTROLLER
        help
            Select UART Device for exmaple.
            please note that not all developemnt boards support all following
            devices, and even the boards support following devices, users
            should also initialize target VFS drivers in "Wasmachine".

        config UART_DEVICE_UART0
            bool "UART0"

        config UART_DEVICE_USB_SERIAL_JTAG_CONTROLLER
            bool "USB Serial/JTAG Controller"
    endchoice

endmenu
```

## examples/protocols/esp_http_client/main/Kconfig.projbuild
```kconfig
menu "Example Configuration"

    config ESP_HTTP_CLIENT_ENABLE_BASIC_AUTH
        bool "Enable HTTP Basic Authentication"
        default n
        help
            This option will enable HTTP Basic Authentication. It is disabled by default as Basic
            auth uses unencrypted encoding, so it introduces a vulnerability when not using TLS

    config ESP_HTTP_CLIENT_ENABLE_DIGEST_AUTH
        bool "Enable HTTP Digest Authentication"
        default y
        help
            This option will enable HTTP Digest Authentication. It is enabled by default, but use of this
            configuration is not recommended as the password can be derived from the exchange, so it introduces
            a vulnerability when not using TLS

endmenu
```

## examples/protocols/mqtt/generic/main/Kconfig.projbuild
```kconfig
menu "Example Configuration"

    choice BROKER_URI
        prompt "Broker URL"
        default TCP_BROKER_URI
        help
            URL of an mqtt broker which this example connects to.
        
        config SSL_BROKER_URI
            bool "SSL"
        config TCP_BROKER_URI
            bool "TCP"
        config WS_BROKER_URI
            bool "WS"
        config WSS_BROKER_URI
            bool "WSS"
    endchoice

    config BROKER_URI
        string
        default "mqtts://mqtt.eclipseprojects.io:8883" if SSL_BROKER_URI
        default "mqtt://mqtt.eclipseprojects.io" if TCP_BROKER_URI
        default "ws://mqtt.eclipseprojects.io:80/mqtt" if WS_BROKER_URI
        default "wss://mqtt.eclipseprojects.io:443/mqtt" if WSS_BROKER_URI

    config BROKER_CERTIFICATE_OVERRIDE
        string "Broker certificate override"
        default ""
        help
            Please leave empty if broker certificate included from a textfile; otherwise fill in a base64 part of PEM
            format certificate

    config BROKER_CERTIFICATE_OVERRIDDEN
        bool
        default y if BROKER_CERTIFICATE_OVERRIDE != ""

endmenu
```

## examples/protocols/sockets/socket-api/send_recv/sdkconfig.defaults
```kconfig
CONFIG_WAMR_APP_FRAMEWORK=y
CONFIG_COMPILER_WASI_NO_USE_STDLIB=n
CONFIG_COMPILER_WASI_USE_SHARED_MEMORY=y
```

## examples/protocols/sockets/tcp_client/main/Kconfig.projbuild
```kconfig
menu "Example Configuration"

    choice EXAMPLE_IP_MODE
        prompt "IP Version"
        depends on EXAMPLE_SOCKET_IP_INPUT_STRING
        help
            Example can use either IPV4 or IPV6.

        config EXAMPLE_IPV4
            bool "IPV4"

        config EXAMPLE_IPV6
            bool "IPV6"

    endchoice

    config EXAMPLE_IPV4_ADDR
        string "IPV4 Address"
        default "192.168.0.165"
        depends on EXAMPLE_IPV4
        help
            The example will connect to this IPV4 address.

    config EXAMPLE_IPV6_ADDR
        string "IPV6 Address"
        default "FE80::30AD:E57B:C212:68AD"
        depends on EXAMPLE_IPV6
        help
            The example will connect to this IPV6 address.

    config EXAMPLE_PORT
        int "Port"
        range 0 65535
        default 3333
        help
            The remote port to which the client example will connect to.

    choice EXAMPLE_SOCKET_IP_INPUT
        prompt "Socket example source"
        default EXAMPLE_SOCKET_IP_INPUT_STRING
        help
            Selects the input source of the IP used in the example.

        config EXAMPLE_SOCKET_IP_INPUT_STRING
            bool "From string"
    endchoice

    config EXAMPLE_SOCKET_SOCKNAME
        bool "Example of retrieve the local address"
        default n
        help
            Retrieve the local address to which the socket is bound.

    config EXAMPLE_SOCKET_PEERNAME
        bool "Example of retrieve the remote address"
        default n
        help
            Retrieve the remote address to which the socket is connected to.

    config EXAMPLE_SOCKET_REUSEADDR
        bool "Example of address reuse"
        default n
        help
            Retrieve status of address reuse and enable/disable address reuse on a socket.
    
    config EXAMPLE_SOCKET_REUSEPORT
        bool "Example of port reuse"
        default n
        help
            Retrieve status of port reuse and enable/disable port reuse on a socket.

    config EXAMPLE_SOCKET_SNDBUF
        bool "Example of send buffer"
        default n
        help
            Retrieve and set the size of send buffer on a socket.
    
    config EXAMPLE_SOCKET_RCVBUF
        bool "Example of receive buffer"
        default n
        help
            Retrieve and set the size of receive buffer on a socket.

endmenu
```
