## examples/gui/lv_demos/lv_demo_music/sdkconfig.defaults
```kconfig
CONFIG_COMPILER_WASI_INITIAL_MEMORY=720896
CONFIG_COMPILER_WASI_MAX_MEMORY=720896
CONFIG_WAMR_APP_FRAMEWORK=y
```

## examples/gui/lv_demos/lv_demo_widgets/sdkconfig.defaults
```kconfig
CONFIG_COMPILER_WASI_INITIAL_MEMORY=196608
CONFIG_COMPILER_WASI_MAX_MEMORY=196608
CONFIG_WAMR_APP_FRAMEWORK=y
```
